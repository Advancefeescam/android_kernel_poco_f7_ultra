## drivers/power/supply/hq_chg/fuelgauge/Kconfig
```kconfig
#SPDX-License-Identifier: GPL-2.0

config BATTERY_FUEL_GAUGE
	tristate "battery fuel gauge"
	default n
	help
		Say Y here to support battery fuel gauge.

config BQ_FUEL_GAUGE
	tristate "TI fuel gauge"
	default n
	help
		Say Y here to support TI fuel gauge.

config HUAQIN_FUEL_ALGORITHM
	tristate "support huaqin fuel algorithm"
	default n
	help
		Say Y here to support huaqin fuel algorithm

config HUAQIN_SOC_SMOOTH_SUPPORT
	tristate "support soc smooth support"
	default n
	help
		Say Y here to support soc smooth

config HUAQIN_SOC_REACH_100_ALGO_SUPPORT
	tristate "support soc reach 100 algo support"
	default n
	help
		Say Y here to support soc reach 100 algo
```

## drivers/power/supply/hq_chg/subpmic/Kconfig
```kconfig
# SPDX-License-Identifier: GPL-2.0
# southchip subpmic
source "drivers/power/supply/hq_chg/subpmic/southchip/Kconfig"

# silergy subpmic
source "drivers/power/supply/hq_chg/subpmic/silergy/Kconfig"

# nuvolta subpmic
source "drivers/power/supply/hq_chg/subpmic/nuvolta/Kconfig"

config SUBPMIC_SOUTHCHIP
	tristate "use southchip subpmic charge architecture"
	default n
	help
	  Say Y to support southchip subpmic charge architecture.
	  Say M here if you want to compile this driver as a module.

config SUBPMIC_SILERGY
	tristate "use silergy subpmic charge architecture"
	default n
	help
	  Say Y to support silergy subpmic charge architecture.
	  Say M here if you want to compile this driver as a module.

config SUBPMIC_NUVOLTA
	tristate "use nuvolta subpmic charge architecture"
	default n
	help
	  Say Y to support nuvolta subpmic charge architecture.
	  Say M here if you want to compile this driver as a module.
```

## drivers/power/supply/hq_chg/subpmic/nuvolta/Kconfig
```kconfig
# SPDX-License-Identifier: GPL-2.0
config NU_SUBPMIC_NU6601
	tristate "nuvolta nu6601 subpmic driver"
	default n
	help
	  Say Y to support nuvolta subpmic nu6601 device driver.
	  Say M here if you want to compile this driver as a module.
```

## drivers/power/supply/hq_chg/subpmic/silergy/Kconfig
```kconfig
# SPDX-License-Identifier: GPL-2.0

config SY_SUBPMIC_SY6976
	tristate "silergy subpmic sy6976 device driver"
	default n
	help
	  Say Y to support silergy subpmic sy6976 device driver.
	  Say M here if you want to compile this driver as a module.

config SY_SUBPMIC_BC12_PROTOCOL
	tristate "silergy subpmic soft bc1.2 protocol"
	default n
	help
	  Say Y to support silergy subpmic soft bc1.2 protocol.
	  Say M here if you want to compile this driver as a module.
```

## drivers/power/supply/hq_chg/subpmic/southchip/Kconfig
```kconfig
# SPDX-License-Identifier: GPL-2.0

config SC_SUBPMIC_SC6601
	tristate "southchip subpmic sc6601 device driver"
	default n
	help
	  Say Y to support southchip subpmic sc6001 device driver.
	  Say M here if you want to compile this driver as a module.

config SC_SUBPMIC_BC12_PROTOCOL
	tristate "southchip subpmic soft bc1.2 protocol"
	default n
	help
	  Say Y to support southchip subpmic soft bc1.2 protocol.
	  Say M here if you want to compile this driver as a module.
```

## drivers/power/supply/lx_chg/Kconfig
```kconfig
# SPDX-License-Identifier: GPL-2.0

#charge_policy
source "drivers/power/supply/lx_chg/charger_policy/Kconfig"

#sc_charger
source "drivers/power/supply/lx_chg/sc_charger/Kconfig"

#protocol
source "drivers/power/supply/lx_chg/sc_charger/protocol/Kconfig"

#subpimc
source "drivers/power/supply/lx_chg/sc_charger/subpmic/Kconfig"

#nu_charger
source "drivers/power/supply/lx_chg/nu_charger/Kconfig"

#nuvolta subpimc
source "drivers/power/supply/lx_chg/nu_charger/subpmic/Kconfig"

#fuelgauge
source "drivers/power/supply/lx_chg/fuelgauge/Kconfig"

#bq_charger
source "drivers/power/supply/lx_chg/bq_charger/Kconfig"

source "drivers/power/supply/lx_chg/battery_secrete/Kconfig"

config LIXUN_ADAPTER_CLASS
	tristate "support hauqin charger adapter class"
	default n
	help
		Say Y here to support hauqin charger adapter class.

config LIXUN_CHARGER_CLASS
	tristate "support hauqin charger class"
	default n
	help
		Say Y here to support hauqin charger class.

config LIXUN_CP_CLASS
	tristate "support hauqin chager pump class"
	default n
	help
		Say Y here to support hauqin chager pump class.

config PD_BATTERY_SECRET
	tristate "pd battery secret"
	default n
	help
		Say Y here to support pd battery secret.

config XIAOMI_SMART_CHG
        tristate "support xiaomi smart charge"
        default n
        help
                Say Y here to support xiaomi smart charge.

config XM_CHG_ANIMATION
        tristate "support xiaomi charge animation"
        default n
        help
                Say Y here to support xiaomi charge animation.

config XM_FG_I2C_ERR
        tristate "support xiaomi fg i2c error"
        default n
        help
                Say Y here to support xiaomi fg i2c error.

config LIXUN_ERP_SUPPORT
        tristate "support erp law"
        default n
        help
                Say Y here to support erp law

config LIXUN_SOH2_SUPPORT
        tristate "support soh2 algo"
        default n
        help
                Say Y here to support soh2 algo

config IS_P7_PROJECT
        tristate "support p7 project"
        default n
        help
                Say Y here to support p7 project
```

## drivers/power/supply/lx_chg/charger_policy/Kconfig
```kconfig
#SPDX-License-Identifier: GPL-2.0

config LIXUN_CHARGER_MANAGER
	tristate "support hauqin charger manger"
	default n
	help
		Say Y here to support hauqin charger manger.

config LIXUN_CP_POLICY
	tristate "support hauqin charger pump policy"
	default n
	help
		Say Y here to support hauqin charger class.

config LIXUN_QC_POLICY
	tristate "support hauqin qc policy"
	default n
	help
		Say Y here to support hauqin charger class.

config XM_CHG_DFS
	tristate "support xiaomi charge dfs features"
	default n
	help
		Say Y or M to support xiaomi charge dfs features.

config BC12_RETRY_FOR_MI_PD
	tristate "support retry BC1.2"
	default n
	help
		Say Y here to support retry BC1.2.

config LIXUN_SOFT_ITERM_SUPPORT
	tristate "support soft iterm support"
	default n
	help
		Say Y here to support soft iterm.

config LIXUN_ERP_SUPPORT
	tristate "support erp"
	default n
	help
		Say Y here to support erp.

config LIXUN_USE_AUTH_CYCLE_COUNT
	tristate "support soft iterm support"
	default n
	help
		Say Y here to support soft iterm.
```

## drivers/power/supply/lx_chg/fuelgauge/Kconfig
```kconfig
#SPDX-License-Identifier: GPL-2.0

config BQ_FUELGAUGE
	tristate "bq28z610 fuelgauge"
	default n
	help
		Say Y here to support bq28z610 fuelgauge.

config LIXUN_FUEL_ALGORITHM
	tristate "support lixun fuel algorithm"
	default n
	help
		Say Y here to support lixun fuel algorithm

config LIXUN_SOC_SMOOTH_SUPPORT
	tristate "support soc smooth support"
	default n
	help
		Say Y here to support soc smooth

config LIXUN_SOC_REACH_100_ALGO_SUPPORT
	tristate "support soc reach 100 algo support"
	default n
	help
		Say Y here to support soc reach 100 algo
```

## drivers/power/supply/lx_chg/sc_charger/protocol/Kconfig
```kconfig
menuconfig PROTOCOL
	tristate "support protocol for southchip"
	help
	  Say Y here to support protocol.

if PROTOCOL

source "drivers/power/supply/lx_chg/sc_charger/protocol/bc12/Kconfig"

endif
```

## drivers/power/supply/lxchg_v2/Kconfig
```kconfig
#SPDX-License-Identifier: GPL-2.0

config LIXUN_CHARGER_MANAGER
	tristate "support lixun charger manger"
	default n
	help
		Say Y here to support lixun charger manger.


config LIXUN_FUEL_ALGORITHM
	tristate "lxchg common support"
	default n
	help
		Say Y here to lxchg common support.
		
config BQ28Z610_FG_SUPPORT
	tristate "lxchg common support"
	default n
	help
		Say Y here to lxchg common support.
		
config MT6358_FG_SUPPORT
	tristate "lxchg common support"
	default n
	help
		Say Y here to lxchg common support.
		
config BATT_SECRET_VERIFY
	tristate "lxchg common support"
	default n
	help
		Say Y here to lxchg common support.
		
config SC8541_CHARGEPUMP
	tristate "lxchg common support"
	default n
	help
		Say Y here to lxchg common support.

config BQ25960_CHARGEPUMP
	tristate "lxchg common support"
	default n
	help
		Say Y here to lxchg common support.
		
config NU2115_CHARGEPUMP
	tristate "lxchg common support"
	default n
	help
		Say Y here to lxchg common support.

config NU6601_CHARGER
	tristate "lxchg common support"
	default n
	help
		Say Y here to lxchg common support.
		
config SC6601_CHARGER
	tristate "lxchg common support"
	default n
	help
		Say Y here to lxchg common support.

config BATT_VERIFY_BY_DS28E30
	tristate "lxchg common support"
	default n
	help
		Say Y here to lxchg common support.
		
config BATT_VERIFY_BY_SLG
	tristate "lxchg common support"
	default n
	help
		Say Y here to lxchg common support.

config BATT_VERIFY_BY_ST
	tristate "lxchg common support"
	default n
	help
		Say Y here to lxchg common support.

config PD_BATTERY_SECRET
	tristate "lxchg common support"
	default n
	help
		Say Y here to lxchg common support.

config XM_CHG_ANIMATION
	tristate "lxchg common support"
	default n
	help
		Say Y here to lxchg common support.

config XIAOMI_SMART_CHG
	tristate "lxchg common support"
	default n
	help
		Say Y here to lxchg common support.

config BATT_VERIFY_SLG_V2
	tristate "lxchg common support"
	default n
	help
		Say Y here to lxchg common support.

config BATT_VERIFY_SLG_V1
	tristate "lxchg common support"
	default n
	help
		Say Y here to lxchg common support.

config LIXUN_SOC_SMOOTH_SUPPORT
	tristate "lxchg common support"
	default n
	help
		Say Y here to lxchg common support.

config LIXUN_SOC_REACH_100_ALGO_SUPPORT
	tristate "lxchg common support"
	default n
	help
		Say Y here to lxchg common support.

config LIXUN_SOFT_ITERM_SUPPORT
	tristate "lxchg common support"
	default n
	help
		Say Y here to lxchg common support.

config LIXUN_SOH2_SUPPORT
	tristate "lxchg common support"
	default n
	help
		Say Y here to lxchg common support.

config LIXUN_USE_AUTH_CYCLE_COUNT
	tristate "lxchg common support"
	default n
	help
		Say Y here to lxchg common support.
```

## drivers/xiaomi/mi_mpam/Kconfig
```kconfig
config ANDROID_MPAM_ARCH
       depends on QTI_MPAM
       tristate "MPAM module based architecture driver"

config ANDROID_MPAM_POLICY
       tristate "MPAM policy module"
       depends on ANDROID_MPAM_ARCH && ANDROID_VENDOR_HOOKS

config MPAM_ENABLE_TOPAPP
       bool "Allow mpam topapp"
       default y
       help
         This enables TOPAPP tasks into MPAM partid 17.
```
