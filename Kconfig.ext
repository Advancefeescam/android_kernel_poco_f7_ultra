## Kconfig.ext
```kconfig
# SPDX-License-Identifier: GPL-2.0
# This file is intentionally empty. It's used as a placeholder for when
# KCONFIG_EXT_PREFIX isn't defined.

config FACTORY_BUILD
	bool "distiguish factory version from dev version"
	default n
	help
	  This macro will be defined when build factory version. It is used to
	  distinguish factory and dev codes in kernel.
```

## drivers/hdbds/Kconfig
```kconfig
config BEIDOU_HD7010
	tristate "HDBDs SMS device"
    help
	  HD BeiDou short packet kernel driver, used to adapt to the short packet chip.
```

## drivers/misc/mediatek/typec/Kconfig
```kconfig
#
# MediaTek USB TYPEC Driver
#

config MTK_USB_TYPEC
	tristate "Mediatek USB TYPE-C Driver"
	help
	  Enables to support usb-c. So the usb device and host driver register
	  the callback func to the usb-c driver. When the usb-c driver detect
	  a device/host plugged in/out, it will notify the device/host driver
	  by callback func.
	  If unsure, say N.

# ===============================================================================
# SPDX-License-Identifier: GPL-2.0
config MTK_USB_TYPEC_MUX
	tristate "Mediatek USB TYPE-C Mux Driver"
        select MTK_USB_TYPEC
	help
	  Say Y or M to support Mediatek USB Type-c mux switch
	  driver. MTK Type-c mux driver is a simple architecture
	  mux driver and  control multiple mux switch IC. Works
	  with Type-C Port Controller Manager

config TYPEC_MUX_FUSB304
	tristate "TI FUSB304 Type-C cross switch driver"
	depends on MTK_USB_TYPEC_MUX
	help
	  Say Y or M if your system has a TI FUSB304
	  Type-C cross switch / mux chip found on some
	  devices with a Type-C port. Works with Type-C
	  Port Controller Manager.

config TYPEC_MUX_PTN36241G
	tristate "NXP PTN36241G USB3 Redriver"
	depends on MTK_USB_TYPEC_MUX
	help
	  Say Y or M if your system has a NXP PTN36241G USB3.0 Redriver.
	  Works with Type-C Port Controller Manager.

config TYPEC_MUX_PS5169
	tristate "Parade PS5169 USB Type-C Linear Redriver"
	depends on MTK_USB_TYPEC_MUX
	help
	  Say Y or M if your system has a PS5169 USB Type-C Linear Redriver.
	  Works with Type-C Port Controller Manager.

config TYPEC_MUX_PS5170
	tristate "Parade PS5170 USB Type-C Linear Redriver"
	depends on MTK_USB_TYPEC_MUX
	help
	  Say Y or M if your system has a PS5170 USB Type-C Linear Redriver.
	  Support USB/DP signal switch.

config TYPEC_MUX_DP_SELECTOR
	tristate "USB DP SIGNAL SELECTOR"
	depends on MTK_USB_TYPEC_MUX
	help
	  Say Y or M if your system has a integrate USB/DP selector.
	  Support USB/DP channel switch.
	  Works with Type-C Port Controller Manager.
	  If unsure, say N.

config MTK_USB_TYPEC_DP_MUX
    tristate "Mediatek USB TYPE-C USB DP Mux"
    depends on MTK_USB_TYPEC_MUX
    help
      Enables to support USB DP mux in usb-c.
      To support TYPE-C USB DP must have a MUX to switch
      SSRX1/SSTX1/SSRX2/SSTX2 pins.
      Say Y to enable TYPEC DP Mux
      If unsure, say N.

config TYPEC_MUX_ALPHA_FSA4480
	tristate "alpha phone FSA4480 aux channel switch IC"
	help
	  Say Y or M if your system has a FSA4480 switch IC.
	  Support DP aux channel switch function.
	  Support typec analog audio switch.
	  Support turn on source vbus function.


#============================================================================
#
# TypeC Port Controller Device Configuration
#

config TCPC_CLASS
	tristate "TypeC Port Controller Device Class"
	select MTK_USB_TYPEC
	select RT_REGMAP
	select TYPEC
	help
	  Say Y to enable
	  Typec Port
	  Controller Device
	  Class

config USB_POWER_DELIVERY
	tristate "Support USB power delivery Function"
	depends on TCPC_CLASS
	default n
	help
	  Say Y to enable
	  USB
	  Power Delivery
	  support

config TCPC_RT1711H
	tristate "Richtek RT1711H TypeC port Controller Driver"
	depends on TCPC_CLASS
	default n
	help
	  Say Y to enable
	  Richtek RT1711H
	  TypeC port Controller
	  Driver

config TCPC_RT5081
	tristate "Richtek RT5081 TypeC port Controller Driver"
	depends on TCPC_CLASS
	default n
	help
	  Say Y to enable Richtek RT5081
	  TypeC port Controller
	  Also Support Power Delivery
	  Say N to disable

config TCPC_MT6360
	tristate "MediaTek MT6360 TypeC port Controller Driver"
	depends on TCPC_CLASS
	help
	  Say Y to enable MediaTek MT6370
	  TypeC port Controller
	  Also Support Power Delivery
	  Say N to disable

config TCPC_WUSB3801
	tristate "MediaTek WUSB3801 TypeC port Controller Driver"
	depends on TCPC_CLASS
	help
	  Say Y to enable WUSB3801
	  TypeC port Controller
	  Also Support Power Delivery
	  Say N to disable

config TCPC_FUSB303
	tristate "MediaTek FUSB303 TypeC port Controller Driver"
	depends on TCPC_CLASS
	help
	  Say Y to enable FUSB303
	  TypeC port Controller
	  Also Support Power Delivery
	  Say N to disable

config TCPC_MT6362
	tristate "MT6362 SPMI TCPC driver"
	depends on TCPC_CLASS
	depends on MFD_MT6362
	help
	  Say yes here to have support for the MT6362 TCPC
	  Support TypeC port Controller and Power Delivery

	  The driver can also be build as a module.
	  If so, the module will be called tcpci_mt6362

config TCPC_MT6370
	tristate "MediaTek MT6370 TypeC port Controller Driver"
	depends on TCPC_CLASS
	default n
	help
	  Say Y to enable MediaTek MT6370
	  TypeC port Controller
	  Also Support Power Delivery
	  Say N to disable

config TCPC_MT6375
	tristate "Mediatek MT6375 Type-C chip driver"
	depends on TCPC_CLASS
	depends on MFD_MT6375
	help
	  Mediatek MT6375 Type-C chip driver that works with
	  Type-C Port Controller Manager to provide USB PD and USB
	  Type-C functionalities.

config USB_PD_VBUS_STABLE_TOUT
	int "PD VBUS Stable Timeout"
	depends on USB_POWER_DELIVERY
	range 0 1000                       # >= 0,  <= 1000
	default 125
	help
	  Setup a timeout value (ms)
	  for
	  VBUS change
	  stable

config PD_DBG_INFO
	tristate "PD debug information"
	depends on TCPC_CLASS
	default y
	help
	  Say Y to enable PD debug
	  for PD DBG
	  information
	  Say N to disable

config MTK_TYPEC_WATER_DETECT
	tristate "Water detection function for type-c connector"
	depends on TCPC_CLASS
	help
	  Say Yes to enable water detection on type-c connector.
	  If water is detected on the connector, it will show
	  warning to notify end user.
	  If unsure, say N.

config MTK_TYPEC_WATER_DETECT_BY_PCB
	tristate "Let PCB decides enabling water detection or not"
	depends on MTK_TYPEC_WATER_DETECT
	help
	  Query GPIO on PCB to judge whether type-c water detection
	  need to be enabled.
	  Say Yes to let PCB decides enabling water detection or not.
	  If unsure, say N.
```

## drivers/power/Kconfig
```kconfig
# SPDX-License-Identifier: GPL-2.0-only
source "drivers/power/reset/Kconfig"
source "drivers/power/supply/Kconfig"

source "drivers/power/supply/hq_chg/Kconfig"

# P6 code for HQFEAT-123538 by p-gaobowei1 at 2025/06/11 start
source "drivers/power/byp/Kconfig"
# P6 code for HQFEAT-123538 by p-gaobowei1 at 2025/06/11 end
```

## drivers/power/supply/hq_chg/Kconfig
```kconfig
# SPDX-License-Identifier: GPL-2.0
# common utils
source "drivers/power/supply/hq_chg/common/Kconfig"

# charge_policy
source "drivers/power/supply/hq_chg/charger_policy/Kconfig"

# charger class
source "drivers/power/supply/hq_chg/charger_class/Kconfig"

# subpmic
source "drivers/power/supply/hq_chg/subpmic/Kconfig"

# chargepump
source "drivers/power/supply/hq_chg/chargepump/Kconfig"

# fuelgauge
source "drivers/power/supply/hq_chg/fuelgauge/Kconfig"

# battery secret
source "drivers/power/supply/hq_chg/battery_secrete/Kconfig"

config CHARGE_ARCH_SUBPMIC
	tristate "charge hardware architecture with subpmic"
	default n
	help
	  Say Y to support charge hardware architecture with subpmic.
	  Say M here if you want to compile this driver as a module.

config CHARGE_ARCH_CHARGEPUMP
	tristate "charge hardware architecture with chargepump"
	default n
	help
	  Say Y to support charge hardware architecture with chargepump.
	  Say M here if you want to compile this driver as a module.

config CHARGE_ARCH_DUAL_CHARGEPUMP
	tristate "charge hardware architecture with dual chargepump"
	default n
	help
	  Say Y to support charge hardware architecture with dual chargepump.
	  Say M here if you want to compile this driver as a module.

config CHARGE_ARCH_FUELGAUGE
	tristate "charge hardware architecture with fuelgauge"
	default n
	help
	  Say Y to support charge hardware architecture with fuelgauge.
	  Say M here if you want to compile this driver as a module.

config CHARGE_ARCH_BATT_AUTH
	tristate "charge hardware architecture with battery authentication"
	  default n
	  help
	    Say Y to support charge hardware architecture with battery authentication.
	    Say M here if you want to compile this driver as a module.

config PD_BATTERY_SECRET
	tristate "pd battery secret"
	default n
	help
	  Say Y here to support pd battery secret.

config XM_CHG_ANIMATION
	tristate "support xiaomi charge animation"
	default n
	help
	  Say Y here to support xiaomi charge animation.

config XM_FG_I2C_ERR
	tristate "support xiaomi fg i2c error"
	default n
	help
	  Say Y here to support xiaomi fg i2c error.

config HUAQIN_ERP_SUPPORT
	tristate "support erp law"
	default n
	help
	  Say Y here to support erp law

config HUAQIN_SOH2_SUPPORT
	tristate "support soh2 algo"
	default n
	help
	  Say Y here to support soh2 algo

config RUST_DETECTION
	bool "support rust detection"
	default n
	help
	support rust detection

config ISC_PROTECT
	bool "support isc protect"
	default n
	help
	support isc protect
```

## drivers/power/supply/hq_chg/chargepump/Kconfig
```kconfig
# SPDX-License-Identifier: GPL-2.0
# southchip chargepump
source "drivers/power/supply/hq_chg/chargepump/southchip/Kconfig"

# nuvolta chargepump
source "drivers/power/supply/hq_chg/chargepump/nuvolta/Kconfig"

# ti chargepump
source "drivers/power/supply/hq_chg/chargepump/ti/Kconfig"

config CHARGEPUMP_SOUTHCHIP
	tristate "use southchip chargepump charge architecture"
	default n
	help
	  Say Y to support southchip chargepump charge architecture.
	  Say M here if you want to compile this driver as a module.

config CHARGEPUMP_NUVOLTA
	tristate "use nuvolta chargepump charge architecture"
	default n
	help
	  Say Y to support nuvolta chargepump charge architecture.
	  Say M here if you want to compile this driver as a module.

config CHARGEPUMP_TI
	tristate "use ti chargepump charge architecture"
	default n
	help
	  Say Y to support ti chargepump charge architecture.
	  Say M here if you want to compile this driver as a module.
```

## drivers/power/supply/hq_chg/chargepump/nuvolta/Kconfig
```kconfig
# SPDX-License-Identifier: GPL-2.0
config NU_CHARGEPUMP_NU2115
	tristate "nuvolta nu2115 chargepump device driver"
	default n
	help
	  Say Y to support nuvolta chargepump nu2115 device driver.
	  Say M here if you want to compile this driver as a module.
```

## drivers/power/supply/hq_chg/chargepump/southchip/Kconfig
```kconfig
# SPDX-License-Identifier: GPL-2.0
config SC_CHARGEPUMP_SC8541
	tristate "southchip sc8541 chargepump device driver"
	default n
	help
	  Say Y to support southchip chargepump sc8541 device driver.
	  Say M here if you want to compile this driver as a module.
```

## drivers/power/supply/hq_chg/chargepump/ti/Kconfig
```kconfig
# SPDX-License-Identifier: GPL-2.0
config TI_CHARGEPUMP_BQ25960
	tristate "ti bq25960 chargepump driver"
	default n
	help
	  Say Y to support ti chargepump bq25960 device driver.
	  Say M here if you want to compile this driver as a module.
```

## drivers/power/supply/hq_chg/charger_class/Kconfig
```kconfig
#SPDX-License-Identifier: GPL-2.0

config HQ_ADAPTER_CLASS
	tristate "support huaqin adapter class"
	default n
	help
		Say Y here to support huaqin charger adapter class.
		Say M here if you want to compile this driver as a module.

config HQ_CHARGER_CLASS
	tristate "support huaqin charger class"
	default n
	help
		Say Y here to support huaqin charger class.
		Say M here if you want to compile this driver as a module.

config HQ_FG_CLASS
	tristate "support huaqin fuel gauge class"
	default n
	help
		Say Y here to support huaqin chager pump class.
		Say M here if you want to compile this driver as a module.

config HQ_CP_CLASS
	tristate "support huaqin chager pump class"
	default n
	help
		Say Y here to support huaqin chager pump class.
		Say M here if you want to compile this driver as a module.

config HQ_LED_CLASS
	tristate "support huaqin led class"
	default n
	help
		Say Y here to support huaqin chager pump class.
		Say M here if you want to compile this driver as a module.

config XM_ADAPTER_CLASS
	tristate "support xiaomi adapter class"
	default n
	help
		Say Y here to support xiaomi adapter class.
		Say M here if you want to compile this driver as a module.
```

## drivers/power/supply/hq_chg/charger_policy/Kconfig
```kconfig
# SPDX-License-Identifier: GPL-2.0
# rainbow charger policy
source "drivers/power/supply/hq_chg/charger_policy/rainbow/Kconfig"

config RAINBOW_CHARGER_POLICY
	tristate "rainbow charger policy"
	default n
	help
	  Say Y to support charger policy for rainbow customer.
	  Say M here if you want to compile this driver as a module.
```

## drivers/power/supply/hq_chg/charger_policy/rainbow/Kconfig
```kconfig
#SPDX-License-Identifier: GPL-2.0

config HUAQIN_CHARGER_MANAGER
	tristate "support hauqin charger manger"
	default n
	help
		Say Y here to support hauqin charger manger.

config HUAQIN_CP_POLICY
	tristate "support hauqin charger pump policy"
	default n
	help
		Say Y here to support hauqin charger class.

config HUAQIN_QC_POLICY
	tristate "support hauqin qc policy"
	default n
	help
		Say Y here to support hauqin charger class.

config HQ_JEITA_POLICY
	tristate "support huaqin jeita policy feature"
	default n
	help
	  Say Y or M to support huaqin jeita policy feature.

config HQ_THERMAL_POLICY
	tristate "support huaqin thermal policy feature"
	default n
	help
	  Say Y or M to support huaqin thermal policy feature.

config HQ_TERM_RECHARGE_POLICY
	tristate "support huaqin terminate and recharge policy feature"
	default n
	help
	  Say Y or M to support huaqin terminate and recharge policy feature.

config HQ_SHUTDOWN_POLICY
	tristate "support huaqin shutdown policy feature"
	default n
	help
	  Say Y or M to support huaqin shutdown policy feature.

config HQ_HIGH_VOLTAGE_DCP
	tristate "support huaqin high voltage dcp feature"
	default n
	help
	  Say Y or M to support high voltage dcp feature.

config HQ_REVERSE_CHARGE_POLICY
	tristate "support huaqin reverse charge feature"
	default n
	help
	  Say Y or M to support huaqin reverse charge feature.

config XM_BATTERY_HEALTH
	tristate "support xiaomi battery health features"
	default n
	help
	  Say Y or M to support xiaomi battery health features.

config XM_SMART_CHG
	tristate "support xiaomi smart charge features"
	default n
	help
	  Say Y or M to support xiaomi smart charge features.

config XM_CHG_DFS
	tristate "support xiaomi charge dfs features"
	default n
	help
	  Say Y or M to support xiaomi charge dfs features.

config BC12_RETRY_FOR_MI_PD
	tristate "support retry BC1.2"
	default n
	help
		Say Y here to support retry BC1.2.

config HUAQIN_SOFT_ITERM_SUPPORT
	tristate "support soft iterm support"
	default n
	help
		Say Y here to support soft iterm.

config XM_CHG_UEVENT
	tristate "support xiaomi charge uevent features"
	default n
	help
		Say Y or M to support xiaomi charge uevent features.

config CHG_ERP_SUPPORT
	tristate "support erp chg features"
	default n
	help
		Say Y here to support erp.
```

## drivers/power/supply/hq_chg/common/Kconfig
```kconfig
# SPDX-License-Identifier: GPL-2.0
config HUAQIN_CHARGER_COMMON
	bool "Support Huaqin Charger Common Utils"
	default y
	help
	  Say Y/M here to support huaqin voter utils

config HUAQIN_VOTER
	depends on HUAQIN_CHARGER_COMMON
	tristate "Support Huaqin Voter Driver"
	default m
	help
	  Say Y/M here to support huaqin voter utils

config HQ_NOTIFY
	depends on HUAQIN_CHARGER_COMMON
	tristate "Support Huaqin Notify Driver"
	default m
	help
	  Say Y/M here to support huaqin notify utils
```
