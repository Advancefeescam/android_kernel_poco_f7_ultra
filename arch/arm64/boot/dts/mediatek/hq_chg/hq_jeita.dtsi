&hq_chg_manager {
	status = "okay";
	step_jeita {
			max_charger_voltage = <12000000>;
			/*normal_cfg: temp_l  temp_h  ibat1  vbat1  ibat2  iterm1  iterm2  iterm3  fv*/
			jeita_normal_cfg = <(-100)	0	500	0	0	250	250	250	4450
							1	50	1000	0	0	250	250	250	4450
							51	100	1900	0	0	250	250	250	4450
							101	150	3450	0	0	250	250	250	4450
							151	350	6000	4250	5400	250	250	250	4430
							351	450	6000	4250	5400	250	250	250	4430
							451	580	2245	0	0	250	250	250	4450>;

			/*ffc_cfg: temp_l  temp_h  ibat1  vbat1  ibat2  vbat2  ibat3  vbat3  ibat4  iterm1  iterm2  iterm3  fv*/
			jeita_ffc_cfg = <151	350	6000	4250	5400	4450	3950	4480	0	850	750	700	4480
						351	450	6000	4250	5400	4450	3950	4480	0	1350	1600	900	4480>;

			step_chg_cfg_bat_cycle = <3600	4220	4800
						4221	4410	4320
						4411	4480	4024>;

			rechg_fv_offset_cfg = <(-100)	0	100
				0	50	100
				50	100	100
				100	150	100
				150	350	100
				350	450	100
				450	580	100>;
	};
};
