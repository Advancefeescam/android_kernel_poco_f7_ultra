## xiaomi-modules/keyboard_driver/violin/Kconfig
```kconfig
config KEYBOARD_XIAOMI_O81A
	tristate "Xiaomi Keyboard"
	help
	  Say Y here if you enable xiaomi keyboard.

	  If unsure, say N.

	  To compile this driver as a module, choose M here:
```

## xiaomi-modules/touch_driver/o81a/Kconfig
```kconfig
#
# NT touchscreen driver configuration
#
config TOUCHSCREEN_XIAOMI_TOUCHFEATURE_O81A
	tristate "Xiaomi Touch Feature"
	depends on INPUT_TOUCHSCREEN
	help
	  Say Y here if you enable xiaomi touch feature.
	  If unsure, say N.
	  To compile this driver as a module, choose M here:

config TOUCHSCREEN_NT36XXX_TCH
	tristate "nt 36532 touchscreen"
```

## xring-configs/xiaomi/build/Kconfig
```kconfig
menu "Xiaomi Modules"
source "../xiaomi-modules/consumerir/Kconfig"
source "../xiaomi-modules/touch_driver/o81a/Kconfig"
source "../xiaomi-modules/mi_led/deco_led/Kconfig"
source "../xiaomi-modules/fingerprint/mi_fp/Kconfig"
source "../xiaomi-modules/vendor_stability/Kconfig"
source "../xiaomi-modules/keyboard_driver/jinghu/Kconfig"
source "../xiaomi-modules/keyboard_driver/violin/Kconfig"
source "../xiaomi-modules/mi_net/Kconfig"
source "../xiaomi-modules/mi_hall/Kconfig"
endmenu
```

## xring-configs/xring_fuzz_defconfig
```kconfig
CONFIG_KCOV=y
CONFIG_KCOV_INSTRUMENT_ALL=y
CONFIG_KCOV_ENABLE_COMPARISONS=y
CONFIG_DEBUG_FS=y
CONFIG_CONFIGFS_FS=y
CONFIG_SECURITYFS=y
CONFIG_DEBUG_INFO=y
CONFIG_DEBUG_KMEMLEAK=y
CONFIG_KALLSYMS=y
CONFIG_KALLSYMS_ALL=y
CONFIG_STACKTRACE=y
CONFIG_PAGE_OWNER=y
CONFIG_XRING_WDT_DISABLE=y
CONFIG_UBSAN=y  # nocheck: fuzz version
CONFIG_CC_HAS_UBSAN_BOUNDS=y  # nocheck: fuzz version
CONFIG_UBSAN_BOUNDS=y # nocheck: fuzz version
CONFIG_UBSAN_ONLY_BOUNDS=y # nocheck: fuzz version
CONFIG_UBSAN_SHIFT=y # nocheck: fuzz version
CONFIG_UBSAN_SANITIZE_ALL=y # nocheck: fuzz version
```

## xring-modules/drivers/spi_apb/Kconfig
```kconfig
config SPI_APB_DRV
	tristate "support kernel spi apb driver"
	help
	  Say yes here to support kernel spi apb
```

## xring-modules/drivers/uft_pcie/Kconfig
```kconfig
config UFT_PCIE_BOOT
	tristate "support uft pcie boot driver"
	help
	  Say yes here to support uft pcie boot
```
